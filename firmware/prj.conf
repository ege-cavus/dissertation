## CMakeLists.txt
```
# ES327 firmware — nRF52840 DK
cmake_minimum_required(VERSION 3.20.0)

# Benchmark uses UART0 on board pins (J-Link exposes it as one of the two /dev/cu.usbmodem* ports).
# No USB overlay — so no need for a second cable.

find_package(Zephyr REQUIRED HINTS $ENV{ZEPHYR_BASE})
project(es327_firmware)

# ---- Model selection (build-time) ----------------------------------------
# nRF sysbuild does NOT forward -D flags to child images. Use environment
# variables: MODEL=bilstm_small west build ... (the env is always visible).
if(DEFINED ENV{MODEL} AND NOT "$ENV{MODEL}" STREQUAL "")
  set(MODEL "$ENV{MODEL}" CACHE STRING "Which model to deploy" FORCE)
elseif(NOT DEFINED MODEL OR "${MODEL}" STREQUAL "")
  set(MODEL "tcn" CACHE STRING "Which model to deploy" FORCE)
endif()
set_property(CACHE MODEL PROPERTY STRINGS tcn bilstm bilstm_small cnnlstm cnnlstm_small transformer pet pet_small)
message(STATUS "Selected model: ${MODEL}")

# ---- Application sources -------------------------------------------------
target_sources(app PRIVATE
    src/main.c
    src/model_runner.cc
)

target_include_directories(app PRIVATE
    src
    src/models
)

string(TOUPPER "${MODEL}" MODEL_UPPER)
target_compile_definitions(app PRIVATE MODEL_${MODEL_UPPER})

# Benchmark mode is controlled by Kconfig CONFIG_ES327_BENCHMARK_MODE.
# To enable: west build ... -- -DCONF_FILE="prj.conf;benchmark.conf"

# ---- TFLite Micro --------------------------------------------------------
# Run  firmware/get_tflm.sh  once to populate tflm/ and its third-party deps.
#
# Compilation strategy:
#  - Use GLOB (not GLOB_RECURSE) for the root micro/ directory so we only get
#    platform-neutral .cc files.
#  - Explicitly add the Zephyr platform subdir (zephyr/) — NOT cortex_m_generic,
#    ceva, arc_custom or cortex_m_corstone_300 which need hardware-specific headers.
#  - Add the ARM toolchain's full C++ stdlib headers as SYSTEM includes because
#    Zephyr builds with -nostdinc++ and its minimal C++ shim is missing <algorithm>,
#    <utility>, <initializer_list> etc. that TFLM needs.

set(TFLM_DIR ${CMAKE_CURRENT_SOURCE_DIR}/tflm)

if(EXISTS "${TFLM_DIR}/tensorflow/lite/micro/micro_interpreter.h")
    message(STATUS "TFLite Micro found at ${TFLM_DIR}")

    # --- Platform-neutral root sources ---
    file(GLOB TFLM_MICRO_ROOT
        "${TFLM_DIR}/tensorflow/lite/micro/*.cc"
    )
    # Exclude test/fake/benchmark files and the generic debug_log.cc.
    # We supply firmware/src/debug_log.cc which routes TFLM messages to Zephyr
    # printk so they appear in RTT alongside application logs.
    list(FILTER TFLM_MICRO_ROOT EXCLUDE REGEX ".*(test|fake|benchmark).*\\.cc$")
    list(FILTER TFLM_MICRO_ROOT EXCLUDE REGEX ".*debug_log\\.cc$")

    # --- Zephyr platform setup (system_setup + micro_time) ---
    # The zephyr/ subdir may not exist in all TFLM checkouts; guard against empty glob.
    file(GLOB TFLM_ZEPHYR_SRCS
        "${TFLM_DIR}/tensorflow/lite/micro/zephyr/*.cc"
    )

    # --- Arena allocator and memory planner ---
    file(GLOB TFLM_ALLOC_SRCS
        "${TFLM_DIR}/tensorflow/lite/micro/arena_allocator/*.cc"
        "${TFLM_DIR}/tensorflow/lite/micro/memory_planner/*.cc"
    )
    list(FILTER TFLM_ALLOC_SRCS EXCLUDE REGEX ".*(test|benchmark).*\\.cc$")

    # --- TFLite bridge (flatbuffer → TFLM conversion helpers) ---
    file(GLOB TFLM_BRIDGE_SRCS
        "${TFLM_DIR}/tensorflow/lite/micro/tflite_bridge/*.cc"
    )
    list(FILTER TFLM_BRIDGE_SRCS EXCLUDE REGEX ".*(test|benchmark).*\\.cc$")

    # --- Reference kernels (platform-neutral baseline) ---
    file(GLOB TFLM_KERNEL_SRCS
        "${TFLM_DIR}/tensorflow/lite/micro/kernels/*.cc"
    )
    list(FILTER TFLM_KERNEL_SRCS EXCLUDE REGEX ".*(test|benchmark).*\\.cc$")

    # --- CMSIS-NN optimised kernels (optional) ---
    # Set USE_CMSIS_NN=OFF to use reference kernels only if Invoke() aborts with
    # CMSIS-NN (e.g. unsupported conv params: dilation, padding, or alignment).
    set(USE_CMSIS_NN ON CACHE BOOL "Use CMSIS-NN optimized kernels")
    if(USE_CMSIS_NN)
        # nRF SDK v3.2.4 ships CMSIS-NN v18.0.0.  For every op that has a
        # cmsis_nn/ replacement we add it and drop the reference kernel.
        file(GLOB TFLM_CMSIS_KERNEL_SRCS
            "${TFLM_DIR}/tensorflow/lite/micro/kernels/cmsis_nn/*.cc"
        )
        list(FILTER TFLM_CMSIS_KERNEL_SRCS EXCLUDE REGEX ".*(test|benchmark).*\\.cc$")
        list(FILTER TFLM_CMSIS_KERNEL_SRCS EXCLUDE REGEX ".*/unidirectional_sequence_lstm\\.cc$")

        # LSTM/CNNLSTM use dynamic-range quant (INT8 weights, float32 activations).
        # CMSIS-NN FullyConnected and Conv reject hybrid; use reference for those builds.
        if(MODEL STREQUAL "bilstm" OR MODEL STREQUAL "bilstm_small" OR MODEL STREQUAL "cnnlstm" OR MODEL STREQUAL "cnnlstm_small")
            list(FILTER TFLM_CMSIS_KERNEL_SRCS EXCLUDE REGEX ".*/fully_connected\\.cc$")
        endif()
        if(MODEL STREQUAL "cnnlstm" OR MODEL STREQUAL "cnnlstm_small")
            list(FILTER TFLM_CMSIS_KERNEL_SRCS EXCLUDE REGEX ".*/conv\\.cc$")
        endif()

        foreach(_KN add batch_matmul conv depthwise_conv fully_connected
                    maximum_minimum mul pad pooling softmax svdf transpose
                    transpose_conv)
            list(FILTER TFLM_KERNEL_SRCS EXCLUDE REGEX ".*/${_KN}\\.cc$")
        endforeach()

        # Re-add reference FullyConnected for LSTM so hybrid (float in, int8 weights) runs.
        if(MODEL STREQUAL "bilstm" OR MODEL STREQUAL "bilstm_small" OR MODEL STREQUAL "cnnlstm" OR MODEL STREQUAL "cnnlstm_small")
            list(APPEND TFLM_KERNEL_SRCS
                "${TFLM_DIR}/tensorflow/lite/micro/kernels/fully_connected.cc")
        endif()
        # Re-add reference Conv for CNNLSTM/cnnlstm_small so hybrid Conv (float in, int8 weights) runs.
        if(MODEL STREQUAL "cnnlstm" OR MODEL STREQUAL "cnnlstm_small")
            list(APPEND TFLM_KERNEL_SRCS
                "${TFLM_DIR}/tensorflow/lite/micro/kernels/conv.cc")
        endif()
    else()
        set(TFLM_CMSIS_KERNEL_SRCS "")
        message(STATUS "CMSIS-NN disabled — using reference kernels")
    endif()

    # --- Lite core helpers ---
    # core/c/common.cc                  → TfLiteTypeGetName, TfLiteIntArrayEqual, TfLiteIntArrayGetSizeInBytes
    # core/api/*.cc                     → flatbuffer_conversions, op_resolver helpers
    # compiler/mlir/.../error_reporter.cc → ErrorReporter::Report / ReportError
    #   (tensorflow/lite/core/api/error_reporter.h is a forwarding header to the mlir path)
    # kernels/internal/tensor_ctypes.cc → GetTensorShape(TfLiteTensor*)
    # kernels/internal/common.cc        → MultiplyByQuantizedMultiplier
    # kernels/internal/portable_tensor_utils.cc → UnpackDenseInt4IntoInt8
    # kernels/internal/quantization_util.cc    → quantization helpers
    # kernels/kernel_util.cc                   → HaveSameShapes
    # compiler/mlir/lite/schema/schema_utils.cc → GetBuiltinCode (same mlir relocation pattern)
    file(GLOB TFLM_LITE_SRCS
        "${TFLM_DIR}/tensorflow/lite/core/c/common.cc"
        "${TFLM_DIR}/tensorflow/lite/core/api/*.cc"
        "${TFLM_DIR}/tensorflow/compiler/mlir/lite/core/api/error_reporter.cc"
        "${TFLM_DIR}/tensorflow/lite/kernels/internal/tensor_ctypes.cc"
        "${TFLM_DIR}/tensorflow/lite/kernels/internal/common.cc"
        "${TFLM_DIR}/tensorflow/lite/kernels/internal/quantization_util.cc"
        # portable_tensor_utils.cc is at the kernels/internal/ root (NOT .../reference/)
        "${TFLM_DIR}/tensorflow/lite/kernels/internal/portable_tensor_utils.cc"
        "${TFLM_DIR}/tensorflow/lite/kernels/kernel_util.cc"
        # reference/comparisons.cc — BroadcastComparison4DSlowPreprocess used by micro/kernels/comparisons.cc (LESS/LESS_EQUAL)
        "${TFLM_DIR}/tensorflow/lite/kernels/internal/reference/comparisons.cc"
        # schema_utils.cc (GetBuiltinCode) lives under the mlir path, same pattern as error_reporter
        "${TFLM_DIR}/tensorflow/compiler/mlir/lite/schema/schema_utils.cc"
    )
    list(FILTER TFLM_LITE_SRCS EXCLUDE REGEX ".*(test|benchmark).*\\.cc$")

    target_sources(app PRIVATE
        ${TFLM_MICRO_ROOT}
        ${TFLM_ZEPHYR_SRCS}
        ${TFLM_ALLOC_SRCS}
        ${TFLM_BRIDGE_SRCS}
        ${TFLM_KERNEL_SRCS}
        ${TFLM_CMSIS_KERNEL_SRCS}
        ${TFLM_LITE_SRCS}
    )

    # --- C++ standard library headers from the Zephyr SDK toolchain ---
    # Zephyr's -nostdinc++ flag hides the toolchain's C++ headers and only
    # exposes its minimal shim.  TFLM needs <algorithm>, <utility>, etc.
    # Adding the ARM toolchain C++ headers as SYSTEM includes restores them
    # without breaking any Zephyr-internal header ordering.
    if(DEFINED ZEPHYR_SDK_INSTALL_DIR)
        file(GLOB _ARM_CXX_DIRS
            "${ZEPHYR_SDK_INSTALL_DIR}/arm-zephyr-eabi/arm-zephyr-eabi/include/c++/[0-9]*"
        )
        if(_ARM_CXX_DIRS)
            list(GET _ARM_CXX_DIRS 0 _ARM_CXX_DIR)
            message(STATUS "ARM C++ headers: ${_ARM_CXX_DIR}")
            target_include_directories(app SYSTEM PRIVATE
                ${_ARM_CXX_DIR}
                ${_ARM_CXX_DIR}/arm-zephyr-eabi
            )
        else()
            message(WARNING "Could not locate ARM C++ headers under ${ZEPHYR_SDK_INSTALL_DIR}")
        endif()
    endif()

    # TFLM + third-party include dirs
    target_include_directories(app PRIVATE
        ${TFLM_DIR}
        ${TFLM_DIR}/third_party/flatbuffers/include
        ${TFLM_DIR}/third_party/gemmlowp
        ${TFLM_DIR}/third_party/ruy
    )

    if(USE_CMSIS_NN)
        if(DEFINED ZEPHYR_CMSIS_NN_MODULE_DIR)
            target_include_directories(app PRIVATE ${ZEPHYR_CMSIS_NN_MODULE_DIR})
            message(STATUS "CMSIS-NN headers: ${ZEPHYR_CMSIS_NN_MODULE_DIR}/Include")
        else()
            message(WARNING "ZEPHYR_CMSIS_NN_MODULE_DIR not set — CMSIS-NN kernels will not compile")
        endif()
        target_compile_definitions(app PRIVATE CMSIS_NN)
    endif()

    target_compile_definitions(app PRIVATE
        TF_LITE_STATIC_MEMORY=1
        TF_LITE_MICRO=1
        FLATBUFFERS_LOCALE_INDEPENDENT=0
    )

    target_compile_options(app PRIVATE
        -Wno-unused-function
        -Wno-sign-compare
        -Wno-unused-variable
        -Wno-type-limits
        -Wno-shadow
    )

else()
    message(WARNING
        "TFLite Micro not found at ${TFLM_DIR}.\n"
        "Run:  bash firmware/get_tflm.sh\n"
        "Building without inference support (stub only)."
    )
    target_compile_definitions(app PRIVATE TFLM_STUB=1)
    target_sources(app PRIVATE src/model_runner_stub.c)
    get_target_property(APP_SRCS app SOURCES)
    list(REMOVE_ITEM APP_SRCS src/model_runner.cc)
    set_property(TARGET app PROPERTY SOURCES ${APP_SRCS})
endif()
```

## Kconfig
```
# ES327 application options (Zephyr base is sourced at the end)

mainmenu "ES327 Application Configuration"

menu "ES327"

config ES327_BENCHMARK_MODE
	bool "Benchmark mode (UART SYNC for benchmark.py)"
	default n
	help
	  When enabled, the firmware waits for SYNC (0xAA) on UART0 and runs
	  the host-driven benchmark loop instead of the normal inference loop.
	  Build with: west build ... -- -DCONF_FILE="prj.conf;benchmark.conf"

endmenu

# Pull in Zephyr's Kconfig (defines GPIO, SERIAL, LOG, etc.)
source "Kconfig.zephyr"
```

## prj.conf
```kconfig
# ES327 firmware — nRF52840 DK
# GPIO, RTT logging, C++ runtime, and TFLite Micro

# ---- GPIO ----------------------------------------------------------------
CONFIG_GPIO=y

# ---- RTT logging ---------------------------------------------------------
CONFIG_USE_SEGGER_RTT=y
CONFIG_SEGGER_RTT_BUFFER_SIZE_UP=4096
CONFIG_LOG=y
CONFIG_LOG_MODE_DEFERRED=y
CONFIG_LOG_BACKEND_RTT=y
CONFIG_LOG_BACKEND_RTT_MODE_BLOCK=y
# Route printk to RTT so TFLM's MicroPrintf (which calls printk) is visible
CONFIG_CONSOLE=y
CONFIG_RTT_CONSOLE=y
CONFIG_LOG_PRINTK=y

# ---- UART (used by benchmark mode to stream data from host) --------------
CONFIG_SERIAL=y
CONFIG_UART_INTERRUPT_DRIVEN=y

# ---- C++ support (required by TFLite Micro) ------------------------------
CONFIG_CPP=y
CONFIG_STD_CPP17=y
CONFIG_REQUIRES_FLOAT_PRINTF=y

# ---- TFLite Micro --------------------------------------------------------
# Enabled when the vendored tflm/ directory is present (see get_tflm.sh).
# CMakeLists.txt guards the TFLM subdirectory with an EXISTS check so the
# project still builds for blinky testing when tflm/ is absent.
CONFIG_FPU=y
CONFIG_FPU_SHARING=y
CONFIG_MAIN_STACK_SIZE=8192
# Reduced so bilstm_small arena (172 KB) + USB stack fits in 256 KB RAM
CONFIG_HEAP_MEM_POOL_SIZE=48128

# ---- CMSIS-NN (speeds up INT8 conv on Cortex-M4 with DSP/SIMD) ----------
# nRF SDK v3.2.4 ships CMSIS-NN v18.0.0 which has all functions required by
# the vendored TFLM snapshot (arm_convolve_wrapper_s8, arm_softmax_s8_s16,
# arm_transpose_s8, etc.).  Enable all sub-modules so the Zephyr build
# system compiles and links the full CMSIS-NN static library.
CONFIG_CMSIS_NN=y
CONFIG_CMSIS_NN_ACTIVATION=y
CONFIG_CMSIS_NN_BASICMATH=y
CONFIG_CMSIS_NN_CONCATENATION=y
CONFIG_CMSIS_NN_CONVOLUTION=y
CONFIG_CMSIS_NN_FULLYCONNECTED=y
CONFIG_CMSIS_NN_NNSUPPORT=y
CONFIG_CMSIS_NN_POOLING=y
CONFIG_CMSIS_NN_RESHAPE=y
CONFIG_CMSIS_NN_SOFTMAX=y
CONFIG_CMSIS_NN_SVD=y
CONFIG_CMSIS_NN_LSTM=y
CONFIG_CMSIS_NN_PAD=y
CONFIG_CMSIS_NN_TRANSPOSE=y
```

## benchmark.conf
```kconfig
# Enable benchmark mode: wait for SYNC on UART0 for benchmark.py
# Use: west build -b nrf52840dk/nrf52840 -p . -- -DCONF_FILE="prj.conf;benchmark.conf"
CONFIG_ES327_BENCHMARK_MODE=y

# RTT tuning for benchmark: larger buffer, drop mode (avoids blocking), immediate mode
CONFIG_SEGGER_RTT_BUFFER_SIZE_UP=4096
CONFIG_LOG_BACKEND_RTT_MODE_BLOCK=n
CONFIG_LOG_BACKEND_RTT_MODE_DROP=y
CONFIG_LOG_BACKEND_RTT_MESSAGE_SIZE=256
CONFIG_LOG_MODE_DEFERRED=n
CONFIG_LOG_MODE_IMMEDIATE=y
```

## prj_benchmark_usb.conf
```kconfig
# Applied only when BENCHMARK=ON. Enables USB CDC ACM so benchmark protocol
# runs over the nRF52's USB (appears as a /dev/cu.usbmodem* or /dev/ttyACM* port).

CONFIG_USB_DEVICE_STACK_NEXT=y
CONFIG_USBD_CDC_ACM_CLASS=y

# Use Zephyr's built-in CDC ACM serial init (enables USB at boot).
CONFIG_CDC_ACM_SERIAL_INITIALIZE_AT_BOOT=y
CONFIG_CDC_ACM_SERIAL_ENABLE_AT_BOOT=y
CONFIG_CDC_ACM_SERIAL_MANUFACTURER_STRING="ES327"
CONFIG_CDC_ACM_SERIAL_PRODUCT_STRING="ES327 Benchmark"
CONFIG_CDC_ACM_SERIAL_VID=0x1915
CONFIG_CDC_ACM_SERIAL_PID=0x52E0

CONFIG_SERIAL=y
CONFIG_UART_LINE_CTRL=y

CONFIG_USBD_CDC_ACM_LOG_LEVEL_ERR=y
```

## nrf52840dk_nrf52840.overlay
```dts
/*
 * Use RTT for console so UART0 is free for benchmark protocol (no log bytes mixed in).
 * UART0 baud 115200; host script must use --baud 115200 (default).
 */
/ {
	rtt0: rtt_chan0 {
		compatible = "segger,rtt-uart";
		status = "okay";
	};

	chosen {
		zephyr,console = &rtt0;
		zephyr,shell-uart = &rtt0;
	};
};

&uart0 {
	status = "okay";
	current-speed = <115200>;
};
```

## nrf52840dk_nrf52840_benchmark_usb.overlay
```dts
/*
 * Benchmark mode only: add USB CDC ACM so the benchmark protocol runs over
 * the nRF52's USB (one of the two /dev/cu.usbmodem* ports). Applied only when
 * building with BENCHMARK=ON.
 */
/ {
	chosen {
		zephyr,benchmark_uart = &cdc_acm_uart0;
	};
};

&zephyr_udc0 {
	cdc_acm_uart0: cdc_acm_uart0 {
		compatible = "zephyr,cdc-acm-uart";
		label = "CDC_ACM_0";
	};
};
```

## src/main.c
```c
/*
 * ES327 firmware — EMG inference on nRF52840 DK
 *
 * Architecture
 * ------------
 *  - A circular ring buffer holds the most recent WIN_SAMPLES × EMG_CHANNELS
 *    z-score-normalised EMG samples.
 *  - Every STRIDE_SAMPLES new samples, a window is copied out of the ring
 *    buffer and passed to the TFLite Micro model runner.
 *  - The model outputs WIN_SAMPLES × N_ANGLES joint angles in radians, of
 *    which the most-recent frame (index WIN_SAMPLES-1) is used as the
 *    current angle estimate and logged over RTT.
 *
 * Signal path (placeholder — replace with real ADC driver)
 * ---------------------------------------------------------
 *  simulate_emg_sample() generates a synthetic sample every SAMPLE_PERIOD_MS.
 *  In a real deployment this would be replaced by a DMA interrupt callback
 *  from the sEMG analogue front-end (e.g. ADS1299 or similar).
 *
 * Memory budget (TCN INT8)
 * -------------------------
 *   Ring buffer:      WIN_SAMPLES × EMG_CHANNELS × 4 B = 64×10×4 = 2.5 KB
 *   Inference input:  WIN_SAMPLES × EMG_CHANNELS × 4 B = 2.5 KB
 *   Inference output: WIN_SAMPLES × N_ANGLES     × 4 B = 64×22×4 = 5.6 KB
 *   TFLM arena:       TFLM_ARENA_SIZE                  = 64 KB
 *   ------------------------------------------------------------------
 *   Total extra RAM:                                    ≈ 74.6 KB
 *   (fits well within the 256 KB SRAM after Zephyr OS ~30 KB overhead)
 */

#include <zephyr/kernel.h>
#include <zephyr/drivers/gpio.h>
#include <zephyr/logging/log.h>

#ifdef CONFIG_ES327_BENCHMARK_MODE
#include <zephyr/drivers/uart.h>
#endif

#include "model_runner.h"

LOG_MODULE_REGISTER(emg_inference, LOG_LEVEL_INF);

/* -------------------------------------------------------------------------
 * LED
 * ------------------------------------------------------------------------- */
#define LED0_NODE DT_ALIAS(led0)
static const struct gpio_dt_spec led = GPIO_DT_SPEC_GET(LED0_NODE, gpios);

/* -------------------------------------------------------------------------
 * Timing
 * ------------------------------------------------------------------------- */
#define SAMPLE_PERIOD_MS   2    /* 500 Hz after 3× downsampling of 1500 Hz */
#define STRIDE_SAMPLES     16   /* run inference every STRIDE_SAMPLES new samples */

/* -------------------------------------------------------------------------
 * Ring buffer  —  [WIN_SAMPLES][EMG_CHANNELS]  float32, z-scored
 *
 * The buffer stores the most recent WIN_SAMPLES frames.
 * write_head points to the *next* position to be written (mod WIN_SAMPLES).
 * ------------------------------------------------------------------------- */
static float  ring_buf[WIN_SAMPLES][EMG_CHANNELS];
static int    write_head   = 0;
static int    samples_since_last_infer = 0;

/* Working buffers reused across inference calls to avoid stack blow-up */
static float  infer_input [WIN_SAMPLES][EMG_CHANNELS];
static float  infer_output[WIN_SAMPLES][N_ANGLES];

/* -------------------------------------------------------------------------
 * Z-score normalisation parameters
 *
 * These must be the *training-set* mean and std — the same values used when
 * building the representative dataset in quantise.py.
 *
 * Replace with the actual values printed by quantise.py when it runs.
 * A convenience: quantise.py prints a C-ready array for you to paste here.
 * ------------------------------------------------------------------------- */
static const float EMG_MEAN[EMG_CHANNELS] = {
    0.0f, 0.0f, 0.0f, 0.0f, 0.0f,
    0.0f, 0.0f, 0.0f, 0.0f, 0.0f,
};
static const float EMG_STD[EMG_CHANNELS] = {
    1.0f, 1.0f, 1.0f, 1.0f, 1.0f,
    1.0f, 1.0f, 1.0f, 1.0f, 1.0f,
};

/* -------------------------------------------------------------------------
 * simulate_emg_sample  (placeholder for real ADC driver)
 *
 * Writes one normalised EMG frame into dst[EMG_CHANNELS].
 * Replace this function body with the real ADC read + z-score step.
 * ------------------------------------------------------------------------- */
static uint32_t s_sim_tick = 0u;

static void simulate_emg_sample(float dst[EMG_CHANNELS])
{
    /* Synthetic signal: low-amplitude sine + noise per channel.
     * This exercises the inference pipeline without real hardware. */
    for (int c = 0; c < EMG_CHANNELS; ++c) {
        /* phase offset per channel so channels are decorrelated */
        float phase = (float)(s_sim_tick + c * 7u) * 0.05f;
        float raw   = 0.3f * (float)((int)(phase * 100) % 200 - 100) / 100.0f;
        dst[c] = (raw - EMG_MEAN[c]) / EMG_STD[c];
    }
    s_sim_tick++;
}

/* -------------------------------------------------------------------------
 * push_sample  —  write one frame into the ring buffer
 * ------------------------------------------------------------------------- */
static void push_sample(const float frame[EMG_CHANNELS])
{
    for (int c = 0; c < EMG_CHANNELS; ++c) {
        ring_buf[write_head][c] = frame[c];
    }
    write_head = (write_head + 1) % WIN_SAMPLES;
    samples_since_last_infer++;
}

/* -------------------------------------------------------------------------
 * copy_window  —  materialise the current ring buffer into a linear array
 * ------------------------------------------------------------------------- */
static void copy_window(float out[WIN_SAMPLES][EMG_CHANNELS])
{
    /* The oldest sample is at write_head (the slot about to be overwritten) */
    for (int i = 0; i < WIN_SAMPLES; ++i) {
        int src = (write_head + i) % WIN_SAMPLES;
        for (int c = 0; c < EMG_CHANNELS; ++c) {
            out[i][c] = ring_buf[src][c];
        }
    }
}

/* -------------------------------------------------------------------------
 * log_angles  —  RTT log of the most-recent (last) frame's angles
 * ------------------------------------------------------------------------- */
static void log_angles(const float angles[WIN_SAMPLES][N_ANGLES])
{
    const float *last = angles[WIN_SAMPLES - 1];
    /* Log wrist angle (index 21) and a few key MCP angles as a sanity check */
    LOG_INF("angles | wrist=%.3f idx_mcp=%.3f mid_mcp=%.3f",
            (double)last[21],
            (double)last[4],
            (double)last[7]);
}

/* =========================================================================
 * BENCHMARK MODE — UART-based dataset benchmark
 *
 * When CONFIG_ES327_BENCHMARK_MODE is set the firmware enters a host-driven loop:
 *   1. Wait for SYNC byte (0xAA) on UART0 (J-Link bridges this to one /dev/cu.usbmodem*).
 *   2. Send ACK (0x55) + arena_used (4 B little-endian).
 *   3. For each window:
 *      - Receive 1 byte: 0x01 = window follows, 0xFF = end.
 *      - Receive WIN_SAMPLES*EMG_CHANNELS*4 bytes of float32 EMG data.
 *      - Run inference, measure cycle count.
 *      - Send inference_us (4 B LE) + WIN_SAMPLES*N_ANGLES*4 bytes of angles.
 *   4. On END (0xFF), send summary and restart wait loop.
 * ========================================================================= */
#ifdef CONFIG_ES327_BENCHMARK_MODE

#define BENCH_SYNC   0xAA
#define BENCH_ACK    0x55
#define BENCH_WINDOW 0x01
#define BENCH_DEBUG  0x02
#define BENCH_END    0xFF

#define INPUT_BYTES  (WIN_SAMPLES * EMG_CHANNELS * (int)sizeof(float))
#define OUTPUT_BYTES (WIN_SAMPLES * N_ANGLES     * (int)sizeof(float))

static const struct device *uart_dev;

static void uart_write_bytes(const uint8_t *buf, size_t len)
{
    for (size_t i = 0; i < len; i++) {
        uart_poll_out(uart_dev, buf[i]);
    }
}

static int uart_read_bytes(uint8_t *buf, size_t len)
{
    for (size_t i = 0; i < len; i++) {
        int rc;
        while ((rc = uart_poll_in(uart_dev, &buf[i])) == -1) {
            k_busy_wait(10);
        }
        if (rc < -1) {
            return rc;
        }
    }
    return 0;
}

static void uart_write_u32(uint32_t val)
{
    uint8_t buf[4];
    buf[0] = (uint8_t)(val);
    buf[1] = (uint8_t)(val >> 8);
    buf[2] = (uint8_t)(val >> 16);
    buf[3] = (uint8_t)(val >> 24);
    uart_write_bytes(buf, 4);
}

static int benchmark_loop(void)
{
    uint32_t arena = (uint32_t)model_runner_arena_used();

    while (1) {
        LOG_INF("Benchmark: waiting for SYNC (0x%02X) on UART0 …", BENCH_SYNC);

        uint8_t sync = 0;
        while (sync != BENCH_SYNC) {
            uart_read_bytes(&sync, 1);
        }

        uint8_t ack = BENCH_ACK;
        uart_write_bytes(&ack, 1);
        uart_write_u32(arena);
        LOG_INF("Benchmark: ACK sent, arena=%u B", arena);

        uint32_t count = 0;
        uint64_t total_us = 0;
        uint32_t min_us = UINT32_MAX, max_us = 0;
        int      errors = 0;

        while (1) {
            uint8_t cmd;
            uart_read_bytes(&cmd, 1);

            if (cmd == BENCH_END) {
                break;
            }
            if (cmd == BENCH_SYNC) {
                /* Host sent SYNC again (e.g. retry) — resync and continue */
                LOG_WRN("SYNC (0xAA) during benchmark — resending ACK");
                uint8_t ack = BENCH_ACK;
                uart_write_bytes(&ack, 1);
                uart_write_u32(arena);
                continue;
            }
            if (cmd == BENCH_DEBUG) {
                /* Host requests output debug: rank, dim1, dim2, raw[8] */
                int rank, dim1, dim2;
                float raw[8];
                model_runner_get_output_debug(&rank, &dim1, &dim2, raw);
                uart_write_u32((uint32_t)rank);
                uart_write_u32((uint32_t)dim1);
                uart_write_u32((uint32_t)dim2);
                uart_write_bytes((const uint8_t *)raw, sizeof(raw));
                continue;
            }
            if (cmd != BENCH_WINDOW) {
                LOG_WRN("Unexpected cmd 0x%02X, skipping", cmd);
                continue;
            }

            uart_read_bytes((uint8_t *)infer_input, INPUT_BYTES);

            /* Use DWT cycle counter (64 MHz CPU clock) for precise timing */
            volatile uint32_t *DWT_CTRL  = (volatile uint32_t *)0xE0001000;
            volatile uint32_t *DWT_CYCCNT = (volatile uint32_t *)0xE0001004;
            volatile uint32_t *DEMCR      = (volatile uint32_t *)0xE000EDFC;
            *DEMCR |= (1 << 24);   /* enable DWT */
            *DWT_CTRL |= 1;        /* enable CYCCNT */
            *DWT_CYCCNT = 0;       /* reset counter */

            int ret = model_runner_infer(infer_input, infer_output);

            uint32_t cycles = *DWT_CYCCNT;
            uint32_t elapsed_us = (uint32_t)(cycles / 64u);  /* 64 MHz -> us */

            if (ret != MODEL_OK) {
                errors++;
                LOG_ERR("Benchmark: inference %u FAILED (ret=%d) after %u us",
                        count, ret, elapsed_us);
            }

            uart_write_u32(elapsed_us);
            uart_write_bytes((const uint8_t *)infer_output, OUTPUT_BYTES);

            count++;
            total_us += elapsed_us;
            if (elapsed_us < min_us) min_us = elapsed_us;
            if (elapsed_us > max_us) max_us = elapsed_us;

            if (count % 10 == 0) {
                gpio_pin_toggle_dt(&led);
            }
        }

        uint32_t avg_us = count > 0 ? (uint32_t)(total_us / count) : 0;
        LOG_INF("Benchmark done: %u inferences, avg=%u us, min=%u us, max=%u us, errors=%d",
                count, avg_us, min_us, max_us, errors);

        uart_write_u32(count);
        uart_write_u32(avg_us);
        uart_write_u32(min_us);
        uart_write_u32(max_us);
    }
    return 0;
}

#endif /* CONFIG_ES327_BENCHMARK_MODE */

/* -------------------------------------------------------------------------
 * main
 * ------------------------------------------------------------------------- */
int main(void)
{
    int ret;

    /* ---- LED init ---- */
    if (!gpio_is_ready_dt(&led)) {
        LOG_ERR("LED not ready");
        return -1;
    }
    ret = gpio_pin_configure_dt(&led, GPIO_OUTPUT_ACTIVE);
    if (ret < 0) {
        LOG_ERR("LED configure failed: %d", ret);
        return ret;
    }

    LOG_INF("ES327 EMG inference firmware starting …");

    /* ---- Model init ---- */
    ret = model_runner_init();
    if (ret != MODEL_OK) {
        LOG_ERR("model_runner_init failed: %d", ret);
        return ret;
    }
    LOG_INF("Model loaded — arena used: %u B", (unsigned)model_runner_arena_used());

#ifdef CONFIG_ES327_BENCHMARK_MODE
    LOG_INF("Build: benchmark mode (waiting for SYNC on UART)");
    /* ---- Benchmark: UART-driven dataset test ---- */
    /* UART0 on nRF52840 DK is wired to the J-Link — one of the two /dev/cu.usbmodem* ports. */
    uart_dev = DEVICE_DT_GET(DT_NODELABEL(uart0));
    if (!device_is_ready(uart_dev)) {
        LOG_INF("Benchmark: UART0 not ready — check CONFIG_SERIAL and board overlay");
        return -1;
    }
    LOG_INF("Benchmark mode — UART ready, waiting for SYNC");
    return benchmark_loop();

#else
    LOG_INF("Build: normal (inference loop)");
    /* ---- Normal sensor-driven inference loop ---- */

    /* Pre-fill ring buffer with zeros so first window is valid */
    float zero_frame[EMG_CHANNELS] = {0};
    for (int i = 0; i < WIN_SAMPLES; ++i) {
        push_sample(zero_frame);
    }
    samples_since_last_infer = 0;

    LOG_INF("Entering inference loop (sample period %d ms, stride %d)",
            SAMPLE_PERIOD_MS, STRIDE_SAMPLES);

    uint32_t infer_count = 0u;

    while (1) {
        /* ---- Acquire one EMG frame ---- */
        float frame[EMG_CHANNELS];
        simulate_emg_sample(frame);
        push_sample(frame);

        /* ---- Run inference every STRIDE_SAMPLES new samples ---- */
        if (samples_since_last_infer >= STRIDE_SAMPLES) {
            samples_since_last_infer = 0;

            copy_window(infer_input);

            ret = model_runner_infer(infer_input, infer_output);
            if (ret != MODEL_OK) {
                LOG_ERR("inference failed: %d", ret);
            } else {
                infer_count++;
                /* Toggle LED to show inference is running */
                gpio_pin_toggle_dt(&led);
                /* Log every 10th inference to avoid flooding RTT */
                if (infer_count % 10u == 0u) {
                    LOG_INF("infer #%u", (unsigned)infer_count);
                    log_angles(infer_output);
                }
            }
        }

        k_msleep(SAMPLE_PERIOD_MS);
    }
#endif /* CONFIG_ES327_BENCHMARK_MODE */

    return 0;
}
```

## src/model_runner.cc
```c
/*
 * model_runner.cc — TFLite Micro inference engine for EMG → joint angles
 *
 * Implements the C interface declared in model_runner.h using the
 * TensorFlow Lite for Microcontrollers (TFLM) C++ API.
 *
 * Supports five model architectures (selected at build time via -DMODEL=xxx):
 *   TCN, BiLSTM, CNN-BiLSTM, Transformer, PET
 *
 * All models share the same I/O contract:
 *   Input:  channels-first [1, EMG_CHANNELS, WIN_SAMPLES] = [1, 10, 64]
 *   Output: channels-first [1, N_ANGLES,     WIN_SAMPLES] = [1, 22, 64]
 *   I/O type: float32 (internal ops are INT8 with QUANTIZE/DEQUANTIZE at
 *             the model boundary)
 *
 * The public API accepts time-first arrays [WIN_SAMPLES][channels] so that
 * main.c can pass the ring-buffer window directly.  The transposition is
 * done here, keeping main.c layout-agnostic.
 */

#include "model_runner.h"

/* ---- TFLite Micro headers ---- */
#include "tensorflow/lite/micro/micro_interpreter.h"
#include "tensorflow/lite/micro/micro_mutable_op_resolver.h"
#include "tensorflow/lite/micro/system_setup.h"
#include "tensorflow/lite/kernels/internal/tensor_ctypes.h"
#include "tensorflow/lite/schema/schema_generated.h"

/* ---- Generated model flatbuffer (selected at build time via -DMODEL=xxx) ---- */
#if defined(MODEL_TCN)
#include "models/tcn_model.h"
static const uint8_t *s_model_data     = tcn_model_data;
static const char   *s_model_name      = "tcn";
#elif defined(MODEL_BILSTM)
#include "models/bilstm_model.h"
static const uint8_t *s_model_data     = bilstm_model_data;
static const char   *s_model_name      = "bilstm";
#elif defined(MODEL_BILSTM_SMALL)
#include "models/bilstm_small_model.h"
static const uint8_t *s_model_data     = bilstm_small_model_data;
static const char   *s_model_name      = "bilstm_small";
#elif defined(MODEL_CNNLSTM)
#include "models/cnnlstm_model.h"
static const uint8_t *s_model_data     = cnnlstm_model_data;
static const char   *s_model_name      = "cnnlstm";
#elif defined(MODEL_CNNLSTM_SMALL)
#include "models/cnnlstm_small_model.h"
static const uint8_t *s_model_data     = cnnlstm_small_model_data;
static const char   *s_model_name      = "cnnlstm_small";
#elif defined(MODEL_TRANSFORMER)
#include "models/transformer_model.h"
static const uint8_t *s_model_data     = transformer_model_data;
static const char   *s_model_name      = "transformer";
#elif defined(MODEL_PET)
#include "models/pet_model.h"
static const uint8_t *s_model_data     = pet_model_data;
static const char   *s_model_name      = "pet";
#elif defined(MODEL_PET_SMALL)
#include "models/pet_small_model.h"
static const uint8_t *s_model_data     = pet_small_model_data;
static const char   *s_model_name      = "pet_small";
#else
#error "No model selected. Pass -DMODEL=tcn|bilstm|bilstm_small|cnnlstm|cnnlstm_small|transformer|pet|pet_small to cmake."
#endif

#include <cstring>
#include <cstdio>
#include <zephyr/sys/printk.h>
#include <zephyr/logging/log.h>
LOG_MODULE_REGISTER(model_runner, LOG_LEVEL_DBG);

/* -------------------------------------------------------------------------
 * Zephyr-native DebugLog — routes TFLM error messages to printk/RTT.
 * Must match the signature expected by micro_log.cc: (const char* format, va_list args)
 * so that MicroPrintf("opcode %d (%s)", code, name) is formatted correctly.
 * ------------------------------------------------------------------------- */
#include <cstdarg>
#include <cstdio>

extern "C" void DebugLog(const char *format, va_list args)
{
    char buf[200];
    int n = std::vsnprintf(buf, sizeof(buf), format, args);
    if (n > 0 && n < (int)sizeof(buf)) {
        printk("%s", buf);
    } else if (format && format[0]) {
        printk("%s", format);  /* fallback if vsnprintf fails */
    }
}

/* -------------------------------------------------------------------------
 * Operator resolver — superset of all ops used by the five model architectures
 *
 * TCN:         Conv2D, Add, ReLU, Pad, StridedSlice, Reshape, Transpose,
 *              SpaceToBatchNd, BatchToSpaceNd, ExpandDims, Squeeze, Slice
 * BiLSTM:      UnidirectionalSequenceLstm, FullyConnected, Tanh, Logistic
 * CNN-BiLSTM:  (BiLSTM ops) + Conv2D, DepthwiseConv2D
 * Transformer: BatchMatMul, Softmax, Gather, ResizeBilinear, Sub, Rsqrt
 * PET:         (Transformer ops) + Concatenation
 *
 * Common:      Quantize, Dequantize, Mul, Mean, Reshape, Transpose, Add
 *
 * If AllocateTensors returns -1, a required op is not registered.
 * Increase the template parameter and add the missing AddXxx() call.
 * ------------------------------------------------------------------------- */
using OpResolver = tflite::MicroMutableOpResolver<52>;

static OpResolver make_resolver()
{
    OpResolver resolver;

    /* --- Convolution / pooling --- */
    resolver.AddConv2D();
    resolver.AddDepthwiseConv2D();
    resolver.AddAveragePool2D();
    resolver.AddMaxPool2D();

    /* --- Elementwise / activation --- */
    resolver.AddAdd();
    resolver.AddMul();
    resolver.AddSub();
    resolver.AddRelu();
    resolver.AddLogistic();
    resolver.AddTanh();
    resolver.AddSoftmax();
    resolver.AddRsqrt();

    /* --- Linear algebra --- */
    resolver.AddFullyConnected();
    resolver.AddBatchMatMul();

    /* --- Shape manipulation --- */
    resolver.AddReshape();
    resolver.AddTranspose();
    resolver.AddExpandDims();
    resolver.AddSqueeze();
    resolver.AddConcatenation();
    resolver.AddGather();
    resolver.AddPack();
    resolver.AddUnpack();
    resolver.AddSplit();        /* BiLSTM: split input/state tensors */

    /* --- TCN dilated-conv support --- */
    resolver.AddPad();
    resolver.AddStridedSlice();
    resolver.AddSlice();
    resolver.AddSpaceToBatchNd();
    resolver.AddBatchToSpaceNd();

    /* --- Quantisation boundary --- */
    resolver.AddQuantize();
    resolver.AddDequantize();

    /* --- Type/shape ops (converter often inserts these for LSTM/Transformer) --- */
    resolver.AddCast();
    resolver.AddFloor();
    resolver.AddExp();
    resolver.AddNeg();
    resolver.AddShape();        /* PET LayerNorm decomposition */

    /* --- Reduction --- */
    resolver.AddMean();

    /* --- Sequence models (BiLSTM, CNN-BiLSTM) --- */
    resolver.AddUnidirectionalSequenceLSTM();
    resolver.AddLess();       /* WHILE condition: i < N */
    resolver.AddLessEqual();  /* WHILE condition: i <= N */
    resolver.AddLogicalAnd(); /* WHILE condition: (i < N) && ... */
    resolver.AddWhile();              /* LSTM loop when not unrolled */
    resolver.AddDynamicUpdateSlice(); /* LSTM h-state scatter (patched while_body) */

    /* --- Transformer / PET interpolation + activation --- */
    resolver.AddResizeBilinear();
    resolver.AddResizeNearestNeighbor();

    /* --- Sum / reduce ops used by LayerNorm, attention normalization --- */
    resolver.AddReduceMax();
    resolver.AddSum();
    resolver.AddSquaredDifference();

    return resolver;
}

/* -------------------------------------------------------------------------
 * Static state
 * ------------------------------------------------------------------------- */
alignas(16) static uint8_t s_arena[TFLM_ARENA_SIZE];
static OpResolver                     s_resolver;
static const tflite::Model           *s_model   = nullptr;
static tflite::MicroInterpreter      *s_interp  = nullptr;
static TfLiteTensor                  *s_input   = nullptr;
static TfLiteTensor                  *s_output  = nullptr;

/* Last inference output debug (for UART debug command) */
static int   s_last_rank = 0, s_last_dim1 = 0, s_last_dim2 = 0;
static float s_last_raw[8] = {0};

/* All models have float32 I/O.  The QUANTIZE / DEQUANTIZE ops inside the
 * flatbuffer handle float32 ↔ INT8 conversion at the model boundary. */

/* -------------------------------------------------------------------------
 * model_runner_init
 * ------------------------------------------------------------------------- */
int model_runner_init(void)
{
    tflite::InitializeTarget();

    s_model = tflite::GetModel(s_model_data);
    if (s_model->version() != TFLITE_SCHEMA_VERSION) {
        return -10;   /* schema version mismatch: model vs TFLM header */
    }

    LOG_INF("Loading model '%s', TFLM_ARENA_SIZE=%u B", s_model_name,
            (unsigned)TFLM_ARENA_SIZE);

    s_resolver = make_resolver();

    /* Placement-new into a small static buffer so we don't need dynamic alloc */
    static uint8_t s_interp_buf[sizeof(tflite::MicroInterpreter)];
    s_interp = new (s_interp_buf)
        tflite::MicroInterpreter(s_model, s_resolver, s_arena, TFLM_ARENA_SIZE);

    if (s_interp->AllocateTensors() != kTfLiteOk) {
        LOG_ERR(
            "model_runner_init: tensor arena too small. Model '%s', "
            "TFLM_ARENA_SIZE=%u B. See TFLM message above for requested size. "
            "Increase TFLM_ARENA_SIZE in model_runner.h or use a smaller model.",
            s_model_name, (unsigned)TFLM_ARENA_SIZE);
        return -20;   /* AllocateTensors failed: unregistered op or arena too small */
    }

    s_input  = s_interp->input(0);
    s_output = s_interp->output(0);

    if (s_input->type != kTfLiteFloat32 || s_output->type != kTfLiteFloat32) {
        LOG_ERR("I/O type mismatch: input=%d output=%d (expected float32=1)",
                (int)s_input->type, (int)s_output->type);
        return -30;
    }

    return MODEL_OK;
}

/* -------------------------------------------------------------------------
 * model_runner_infer
 * ------------------------------------------------------------------------- */
int model_runner_infer(const float emg_window[WIN_SAMPLES][EMG_CHANNELS],
                       float       angles_out[WIN_SAMPLES][N_ANGLES])
{
    if (!s_interp) {
        return MODEL_ERR_INPUT;
    }

    /* Copy EMG window into the float32 input tensor (channels-first layout).
     *
     *   Public API layout:   emg_window[t][c]  — time-first   [WIN][CH]
     *   TFLite input layout: in_data[c * WIN + t] — channels-first [CH][WIN]
     *
     * The model's internal QUANTIZE op converts float32 → INT8 automatically.
     */
    float *in_data = s_input->data.f;
    for (int c = 0; c < EMG_CHANNELS; ++c) {
        for (int t = 0; t < WIN_SAMPLES; ++t) {
            in_data[c * WIN_SAMPLES + t] = emg_window[t][c];
        }
    }

    /* Run inference */
    LOG_INF("Invoke() starting...");
    TfLiteStatus invoke_status = s_interp->Invoke();
    LOG_INF("Invoke() returned %d", (int)invoke_status);
    if (invoke_status != kTfLiteOk) {
        LOG_ERR("Invoke() failed with status %d", (int)invoke_status);
        return MODEL_ERR_INVOKE;
    }

    /* Debug: log raw interpreter output (first 8 floats) to verify TFLM vs copy */
    {
        const float *raw = s_output->data.f;
        LOG_INF("raw out[0..7]=%.4f %.4f %.4f %.4f %.4f %.4f %.4f %.4f",
                (double)raw[0], (double)raw[1], (double)raw[2], (double)raw[3],
                (double)raw[4], (double)raw[5], (double)raw[6], (double)raw[7]);
    }

    /* Copy float32 output tensor to time-first angles_out[t][a].
     * Model may output (1, ANG, WIN) or (1, WIN, ANG) — detect from shape. */
    const float *out_data = s_output->data.f;
    const auto out_shape = tflite::GetTensorShape(s_output);
    const int rank = out_shape.DimensionsCount();
    /* Typical: (1, 22, 64) [ANG][WIN] or (1, 64, 22) [WIN][ANG] */
    const int dim1 = (rank >= 2) ? out_shape.Dims(1) : 1;
    const int dim2 = (rank >= 3) ? out_shape.Dims(2) : 1;
    if (dim1 == N_ANGLES && dim2 == WIN_SAMPLES) {
        /* [batch][ANG][WIN] — index = a * WIN + t */
        for (int t = 0; t < WIN_SAMPLES; ++t) {
            for (int a = 0; a < N_ANGLES; ++a) {
                angles_out[t][a] = out_data[a * WIN_SAMPLES + t];
            }
        }
    } else if (dim1 == WIN_SAMPLES && dim2 == N_ANGLES) {
        /* [batch][WIN][ANG] — index = t * ANG + a */
        for (int t = 0; t < WIN_SAMPLES; ++t) {
            for (int a = 0; a < N_ANGLES; ++a) {
                angles_out[t][a] = out_data[t * N_ANGLES + a];
            }
        }
    } else {
        /* Fallback: assume [ANG][WIN] */
        for (int t = 0; t < WIN_SAMPLES; ++t) {
            for (int a = 0; a < N_ANGLES; ++a) {
                angles_out[t][a] = out_data[a * WIN_SAMPLES + t];
            }
        }
    }

    /* Store debug for UART debug command */
    s_last_rank = rank;
    s_last_dim1 = dim1;
    s_last_dim2 = dim2;
    for (int i = 0; i < 8; ++i) {
        s_last_raw[i] = out_data[i];
    }

    return MODEL_OK;
}

/* -------------------------------------------------------------------------
 * model_runner_get_output_debug
 * ------------------------------------------------------------------------- */
void model_runner_get_output_debug(int *rank, int *dim1, int *dim2, float raw[8])
{
    *rank = s_last_rank;
    *dim1 = s_last_dim1;
    *dim2 = s_last_dim2;
    for (int i = 0; i < 8; ++i) {
        raw[i] = s_last_raw[i];
    }
}

/* -------------------------------------------------------------------------
 * model_runner_arena_used
 * ------------------------------------------------------------------------- */
size_t model_runner_arena_used(void)
{
    if (!s_interp) return 0u;
    return s_interp->arena_used_bytes();
}
```

## src/model_runner.h
```c
/*
 * model_runner.h — C-compatible API for TFLite Micro EMG inference
 *
 * This header exposes a plain-C interface so that main.c (C) can call into
 * the C++ TFLite Micro runtime without knowing anything about it.
 *
 * Supported models (selected at build time via -DMODEL=xxx):
 *   tcn, bilstm, bilstm_small, cnnlstm, cnnlstm_small, transformer, pet
 *
 * Calling sequence
 * ----------------
 *   1. model_runner_init()          — once at startup
 *   2. model_runner_infer(in, out)  — every WIN_SAMPLES once per stride
 *   3. model_runner_arena_used()    — optional: log peak RAM
 */

#pragma once

#include <stdbool.h>
#include <stddef.h>   /* size_t */
#include <stdint.h>

#ifdef __cplusplus
extern "C" {
#endif

/* -------------------------------------------------------------------------
 * Dimensions — shared across all models (match quantise.py constants)
 * ------------------------------------------------------------------------- */
#define EMG_CHANNELS   10     /* sEMG input channels                         */
#define WIN_SAMPLES    64     /* window length in (downsampled) samples       */
#define N_ANGLES       22     /* output: CyberGlove joint angles              */

/* -------------------------------------------------------------------------
 * Tensor arena size
 *
 * nRF52840 has 256 KB RAM total.  After Zephyr OS overhead (~30 KB),
 * ring buffers, and stack, ~200 KB remains for the tensor arena.
 *
 * Arena usage varies by model — call model_runner_arena_used() after one
 * inference to see the actual high-water mark.
 *
 * BiLSTM with WHILE (non-unrolled) can request ~860 KB from TFLM's planner,
 * which exceeds nRF52840 RAM. To fit, use a smaller model: shorter sequence
 * (e.g. WIN=32), fewer hidden units, or fewer LSTM layers; or deploy on a
 * board with more RAM.
 *
 * Measured / estimated arena usage per model (INT8):
 *   TCN:           ~71 KB
 *   bilstm_small:  ~164 KB (fits)
 *   cnnlstm_small: ~120–170 KB (fits; 32 CNN ch, 64 hidden, 1 LSTM layer)
 *   BiLSTM/cnnlstm: WHILE-based graph often requests ~860 KB (does not fit)
 *   Transformer:   ~90 KB  (estimate)
 *   PET:           ~95 KB  (estimate)
 * ------------------------------------------------------------------------- */
#define TFLM_ARENA_SIZE (172 * 1024)  /* 172 KB — bilstm_small needs ~164 KB at runtime; heap reduced in prj.conf */

/* -------------------------------------------------------------------------
 * Error codes
 * ------------------------------------------------------------------------- */
#define MODEL_OK            0
#define MODEL_ERR_ALLOC    -1
#define MODEL_ERR_INPUT    -2
#define MODEL_ERR_INVOKE   -3

/* -------------------------------------------------------------------------
 * Public API
 * ------------------------------------------------------------------------- */

/**
 * model_runner_init
 *
 * Initialises TFLite Micro interpreter, allocates the tensor arena, and
 * loads the embedded model (selected at build time via -DMODEL=xxx,
 * from firmware/src/models/<name>_model.h).
 *
 * Must be called once before any call to model_runner_infer().
 *
 * @return MODEL_OK on success, negative error code on failure.
 */
int model_runner_init(void);

/**
 * model_runner_infer
 *
 * Run one forward pass of the INT8 model.
 *
 * @param emg_window   Pointer to a [WIN_SAMPLES][EMG_CHANNELS] float32 array.
 *                     Values must be z-score normalised (mean=0, std=1) using
 *                     the same statistics computed during training.
 * @param angles_out   Pointer to a [WIN_SAMPLES][N_ANGLES] float32 array.
 *                     Filled with predicted joint angles in radians on return.
 *
 * @return MODEL_OK on success, negative error code on failure.
 */
int model_runner_infer(const float emg_window[WIN_SAMPLES][EMG_CHANNELS],
                       float       angles_out[WIN_SAMPLES][N_ANGLES]);

/**
 * model_runner_arena_used
 *
 * @return Number of bytes currently used in the tensor arena.
 *         Call after at least one successful model_runner_infer() for a
 *         meaningful value.
 */
size_t model_runner_arena_used(void);

/**
 * model_runner_get_output_debug
 *
 * Returns output tensor shape and first 8 raw floats from the last inference.
 * Use for UART debug when RTT is unavailable.
 *
 * @param rank  Output: tensor rank (typically 3)
 * @param dim1  Output: shape[1] (22 or 64)
 * @param dim2  Output: shape[2] (64 or 22)
 * @param raw   Output: first 8 floats from interpreter output buffer
 */
void model_runner_get_output_debug(int *rank, int *dim1, int *dim2, float raw[8]);

#ifdef __cplusplus
}  /* extern "C" */
#endif
```

## src/model_runner_stub.c
```c
/*
 * model_runner_stub.c — no-op model runner compiled when TFLM is absent
 *
 * This file is compiled instead of model_runner.cc when the tflm/ directory
 * is missing (i.e. get_tflm.sh has not been run yet). It allows the
 * firmware to compile and run as a blinky so the board bring-up workflow
 * is not gated on the TFLM dependency.
 *
 * Once get_tflm.sh has been run and model_runner.cc is active, this file
 * is excluded by the CMakeLists.txt guard.
 */

#ifdef TFLM_STUB

#include "model_runner.h"
#include <zephyr/logging/log.h>
#include <string.h>

LOG_MODULE_DECLARE(emg_inference, LOG_LEVEL_INF);

int model_runner_init(void)
{
    LOG_WRN("TFLM stub: no model loaded (run firmware/get_tflm.sh)");
    return MODEL_OK;
}

int model_runner_infer(const float emg_window[WIN_SAMPLES][EMG_CHANNELS],
                       float       angles_out[WIN_SAMPLES][N_ANGLES])
{
    /* Return zeros — stub behaviour */
    memset(angles_out, 0, sizeof(float) * WIN_SAMPLES * N_ANGLES);
    return MODEL_OK;
}

size_t model_runner_arena_used(void)
{
    return 0u;
}

void model_runner_get_output_debug(int *rank, int *dim1, int *dim2, float raw[8])
{
    *rank = 3;
    *dim1 = 22;
    *dim2 = 64;
    for (int i = 0; i < 8; ++i) raw[i] = 0.0f;
}

#endif /* TFLM_STUB */
```
